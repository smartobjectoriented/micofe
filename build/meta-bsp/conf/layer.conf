## build/meta-bsp/recipes-bsp/capsule/files/its/virt64_capsule.its
```
/*
 * Copyright (c) 2020-2026 REDS Institute, HEIG-VD
 * Author: Daniel Rossier <daniel.rossier@heig-vd.ch>
 *
 * This program is free software; you can redistribute it and/or modify
 * it under the terms of the GNU General Public License version 2 as
 * published by the Free Software Foundation.
 *
 * This program is distributed in the hope that it will be useful,
 * but WITHOUT ANY WARRANTY; without even the implied warranty of
 * MERCHANTABILITY or FITNESS FOR A PARTICULAR PURPOSE.  See the
 * GNU General Public License for more details.
 *
 */

/*
 * SO3 capsule ITB template for virt64. The ${IB_*_PATH} placeholders are
 * expanded to absolute build paths by bsp_render_its (bsp-capsules do_itb)
 * before mkimage, so this template is machine-independent while the rendered
 * ITS in ${IB_ITB_PATH} carries resolved /incbin paths.
 */

/dts-v1/;

/ {
	description = "SO3 capsule components for virt64 (armv8) environment";

	images {

		so3 {
			description = "SO3 OS kernel";
			data = /incbin/("${IB_SO3_PATH}/so3/so3.bin");
			type = "guest";
			arch = "arm64";
			os = "linux";
			compression = "none";
			load = <0x41080000>;
			entry = <0x41080000>;
		};

		fdt {
			description = "Flattened Device Tree blob";
			data = /incbin/("${IB_SO3_PATH}/so3/dts/virt64_capsule.dtb");
			type = "flat_dt";
			arch = "arm64";
			compression = "none";
			load = <0x43000000>;
		};

		ramfs {
			description = "SO3 environment minimal rootfs";
			data = /incbin/("${IB_ROOTFS_PATH}/rootfs.fat");
			type = "ramdisk";
			arch = "arm64";
			os = "linux";
			compression = "none";
			load = <0x43500000>;
		};
	};

	configurations {
		default = "so3_ramfs";

		so3_ramfs {
			description = "SO3 kernel image including device tree";
			kernel = "so3";
			fdt = "fdt";
			ramdisk = "ramfs";
		};

		so3_mmc {
			description = "SO3 kernel image including device tree";
			kernel = "so3";
			fdt = "fdt";
		};
	};

};
```

## linux/target/virt64_linux_guest.its
```
/*
 * Copyright (C) 2020-2026 Daniel Rossier <daniel.rossier@heig-vd.ch>
 *
 * Linux agency guest ITB for virt64 (armv8). Carries the Linux agency
 * kernel (Image) + its device tree + initrd. Paired with virt64_avz.itb
 * and loaded by U-Boot's e1c-boot command, which passes this ITB to AVZ
 * in x1; AVZ's loadAgency() loads the agency guest from it. The Linux
 * agency hosts the SO3 capsules (injected at runtime via EMISO).
 *
 * This program is free software; you can redistribute it and/or modify
 * it under the terms of the GNU General Public License version 2 as
 * published by the Free Software Foundation.
 *
 */

/dts-v1/;

/ {
	description = "Linux agency guest bundle for virt64 (armv8)";

	images {

		linux {
			description = "Linux agency kernel (guest)";
			data = /incbin/("../linux/arch/arm64/boot/Image");
			type = "guest";
			arch = "arm64";
			os = "linux";
			compression = "none";
			load = <0x41000000>;
			entry = <0x41000000>;
		};

		fdt {
			description = "Linux agency device tree (AVZ-exposed)";
			data = /incbin/("../linux/arch/arm64/boot/dts/arm/virt64_guest.dtb");
			type = "flat_dt";
			arch = "arm64";
			compression = "none";
			load = <0x50000000>;
		};

		initrd {
			description = "Linux agency initrd";
			data = /incbin/("../rootfs/board/virt64/initrd.cpio");
			type = "ramdisk";
			arch = "arm64";
			os = "linux";
			compression = "none";
			load = <0x50c00000>;
		};
	};

	configurations {
		/* Node name MUST be "capsule": U-Boot's e1c-boot command looks
		 * up the guest config by that fixed name (cmd/e1c_boot.c:
		 * e1c_load_fit(e1c_itb, "capsule", ...)). Same slot as the SO3
		 * guest; here it carries the Linux agency. */
		default = "capsule";

		capsule {
			description = "SOO Linux agency on virt64";
			loadables = "linux";
			fdt = "fdt";
			ramdisk = "initrd";
		};
	};
};
```
