## linux/target/rpi4_64_avz.its
```
/*
 * Copyright (C) 2020-2026 Daniel Rossier <daniel.rossier@heig-vd.ch>
 *
 * This program is free software; you can redistribute it and/or modify
 * it under the terms of the GNU General Public License version 2 as
 * published by the Free Software Foundation.
 *
 * This program is distributed in the hope that it will be useful,
 * but WITHOUT ANY WARRANTY; without even the implied warranty of
 * MERCHANTABILITY or FITNESS FOR A PARTICULAR PURPOSE.  See the
 * GNU General Public License for more details.
 *
 * You should have received a copy of the GNU General Public License
 * along with this program; if not, write to the Free Software
 * Foundation, Inc., 51 Franklin St, Fifth Floor, Boston, MA  02110-1301  USA
 *
 */

/dts-v1/;

/ {
	description = "SOO Agency components for Raspberry Pi 4 64-bit environment";

	images {
        
   		avz {
        		description = "AVZ Hypervisor (64-bit)";
        		data = /incbin/("../../avz/so3.bin");
        		type = "kernel";
        		os = "linux";
        		arch = "arm64";
        		compression = "none";
        		load = <0x00080000>;
        		entry = <0x00080000>;
        	};
        
		avz_dt {
			description = "Flattened Device Tree blob";
			data = /incbin/("../../avz/dts/rpi4_64_avz.dtb");
			type = "avz_dt";
			arch = "arm64";
			compression = "none";
			load = <0x03000000>;
		};

		linux {
			description = "Linux kernel";
			data = /incbin/("../linux/arch/arm64/boot/Image");
			type = "guest";
			arch = "arm64";
			os = "linux";
			compression = "none";
			load = <0x10000000>;
			entry = <0x10000000>;
		};

        fdt {
        	description = "SOO Agency device tree blob";
            data = /incbin/("../linux/arch/arm64/boot/dts/broadcom/bcm2711-rpi-4-b.dtb");
            type = "flat_dt";
            arch = "arm64";
            compression = "none";
            load = <0x20000000>;
        };

		fdt-overlay {
			data = /incbin/("../linux/arch/arm64/boot/dts/overlays/vc4-kms-v3d-pi4.dtbo");
			type = "flat_dt";
			arch = "arm64";
            		compression = "none";
			load = <0x20c00000>;
		};
	
        initrd {
        	description = "Linux initial rootfs (initrd)";
            data = /incbin/("../rootfs/board/rpi4_64/initrd.cpio");
            type = "ramdisk";
            arch = "arm64";
            os = "linux";
            compression = "none";
            load = <0x20e00000>;
        };
    };
	
    configurations {
		default = "linux_guest";
		
        linux_guest {
		description = "Linux/AVZ on RPi4 64-bit";
        	loadables = "avz_dt", "linux";
        	kernel = "avz";
        	fdt = "fdt";
        	ramdisk = "initrd";
		};
	};
};
```

## linux/target/rpi4_64_linux.its
```
/*
 * Copyright (C) 2020-2026 Daniel Rossier <daniel.rossier@heig-vd.ch>
 *
 * This program is free software; you can redistribute it and/or modify
 * it under the terms of the GNU General Public License version 2 as
 * published by the Free Software Foundation.
 *
 * This program is distributed in the hope that it will be useful,
 * but WITHOUT ANY WARRANTY; without even the implied warranty of
 * MERCHANTABILITY or FITNESS FOR A PARTICULAR PURPOSE.  See the
 * GNU General Public License for more details.
 *
 * You should have received a copy of the GNU General Public License
 * along with this program; if not, write to the Free Software
 * Foundation, Inc., 51 Franklin St, Fifth Floor, Boston, MA  02110-1301  USA
 *
 */

/dts-v1/;

/ {
	description = "SOO Agency components for Raspberry Pi 4 64-bit environment";

	images {
        
		linux {
			description = "Linux kernel";
			data = /incbin/("../linux/arch/arm64/boot/Image");
			type = "kernel";
			arch = "arm64";
			os = "linux";
			compression = "none";
			load = <0x01000000>;
			entry = <0x01000000>;
		};

        fdt {
        	description = "SOO Agency device tree blob";
            data = /incbin/("../linux/arch/arm64/boot/dts/broadcom/bcm2711-rpi-4-b.dtb");
            type = "flat_dt";
            arch = "arm64";
            compression = "none";
            load = <0x20000000>;
        };

		fdt-overlay {
			data = /incbin/("../linux/arch/arm64/boot/dts/overlays/vc4-kms-v3d-pi4.dtbo");
			type = "flat_dt";
			arch = "arm64";
            		compression = "none";
			load = <0x20c00000>;
		};
	
        initrd {
        	description = "Linux initial rootfs (initrd)";
            data = /incbin/("../rootfs/board/rpi4_64/initrd.cpio");
            type = "ramdisk";
            arch = "arm64";
            os = "linux";
            compression = "none";
            load = <0x20e00000>;
        };
    };
	
    configurations {
		default = "linux";
		
        linux {
			description = "Linux on RPi4 64-bit";
        	kernel = "linux";
        	fdt = "fdt";
        	ramdisk = "initrd";
		};
	};
};
```
